## drivers/display/Kconfig.gu_vfd
```kconfig
# Noritake GU series VFD configuration options

# Copyright (c) Karoly Molnar
# SPDX-License-Identifier: Apache-2.0

config NORITAKE_GU_VFD
	bool "Noritake GU VFD Graphic display driver"
	default y
	depends on DT_HAS_NORITAKE_GU_VFD_ENABLED
#	select I2C if $(dt_compat_on_bus,$(DT_COMPAT_NORITAKE_GU_VFD),i2c)
#	select SPI if $(dt_compat_on_bus,$(DT_COMPAT_NORITAKE_GU_VFD),spi)
#	select SERIAL if $(dt_compat_on_bus,$(DT_COMPAT_NORITAKE_GU_VFD),uart)
	select GPIO
	select SPI
	help
	  Enable driver for Noritake GU VFD Graphic display

if NORITAKE_GU_VFD

config GU_VFD_DEFAULT_BRIGHTNESS
	int "Noritake GU VFD default brightness"
	default 5
	range 1 7
	help
	  Noritake GU VFD default brightness.

endif # NORITAKE_GU_VFD
```

## dts/bindings/display/noritake,gu_vfd-common.yaml
```yaml
# Copyright (c) 2025 Karoly Molnar
# SPDX-License-Identifier: Apache-2.0

include: display-controller.yaml

description: |
  Noritake GU VFD is High Brightness Dot Graphic Display

properties:
  mb-gpios:
    type: phandle-array
    required: true
    description: GPIO used for Module Busy detection

  reset-gpios:
    type: phandle-array
    description: GPIO used to reset the display
```

## dts/bindings/display/noritake,gu_vfd-i2c.yaml
```yaml
# Copyright (c) 2025 Karoly Molnar
# SPDX-License-Identifier: Apache-2.0

title: Noritake GU series VFD on I2C bus

compatible: "noritake,gu_vfd"

include: ["noritake,gu_vfd-common.yaml", "i2c-device.yaml"]
```

## dts/bindings/display/noritake,gu_vfd-spi.yaml
```yaml
# Copyright (c) 2025 Karoly Molnar
# SPDX-License-Identifier: Apache-2.0

title: Noritake GU series VFD on UART

compatible: "noritake,gu_vfd"

include: ["noritake,gu_vfd-common.yaml", "spi-device.yaml"]
```
